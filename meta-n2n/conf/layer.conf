## meta-n2n/conf/layer.conf
```bitbake
# We have a conf and classes directory, add to BBPATH
BBPATH .= ":${LAYERDIR}"

# We have recipes-* directories, add to BBFILES
BBFILES += "${LAYERDIR}/recipes-*/*/*.bb \
            ${LAYERDIR}/recipes-*/*/*.bbappend"

BBFILE_COLLECTIONS += "../sources/meta-n2n"
BBFILE_PATTERN_../sources/meta-n2n = "^${LAYERDIR}/"
BBFILE_PRIORITY_../sources/meta-n2n = "6"

LAYERSERIES_COMPAT_../sources/meta-n2n = "sumo thud"
```
